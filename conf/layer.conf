## conf/layer.conf
```bitbake
BBPATH .= ":${LAYERDIR}"

BBFILES += "${LAYERDIR}/recipes*/*/*.bb ${LAYERDIR}/recipes*/*/*.bbappend ${LAYERDIR}/images/*.bb"

BBFILE_COLLECTIONS += "meta-st-flutter"
BBFILE_PATTERN_meta-st-flutter := "^${LAYERDIR}/"
BBFILE_PRIORITY_meta-st-flutter = "12"

LAYERSERIES_COMPAT_meta-st-flutter = "dunfell kirkstone"
```
